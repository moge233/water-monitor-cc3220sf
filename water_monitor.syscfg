// These arguments were used when this file was generated. They will be automatically applied on subsequent loads 
// via the GUI or CLI invocations. Run CLI with '--help' for additional information on how to override these arguments.
// @cliArgs --board "/ti/boards/.meta/CC3220SF_LAUNCHXL" --product "simplelink_cc32xx_sdk@3.30.01.02"
// @versions {"data":"2020022712","timestamp":"2020022712","tool":"1.3.1030","templates":"2020022712"}

var RTOS = scripting.addModule("/ti/drivers/RTOS");
var I2C = scripting.addModule("/ti/drivers/I2C", {}, false);
var I2C1 = I2C.addInstance();
var UART = scripting.addModule("/ti/drivers/UART", {}, false);
var UART1 = UART.addInstance();
var Timer = scripting.addModule("/ti/drivers/Timer", {}, false);
var Timer1 = Timer.addInstance();
var Timer2 = Timer.addInstance();
var GPIO = scripting.addModule("/ti/drivers/GPIO", {}, false);
var GPIO1 = GPIO.addInstance();
var GPIO2 = GPIO.addInstance();
// Name - The C/C++ identifier used in applications as the index parameter passed to I2C runtime APIs
I2C1.$name = "CONFIG_I2C_0";
// Use Hardware - Select the hardware to use, or 'None' to use available header pins
I2C1.$hardware = system.deviceData.board.components.LP_I2C;
// Maximum Bit Rate - Maximum bit rate (Kbps) supported by this bus
I2C1.maxBitRate = 400;
var Power = scripting.addModule("/ti/drivers/Power", {}, false);
// Name
Power.parkPins.$name = "ti_drivers_power_PowerCC32XXPins0";
var Board = scripting.addModule("/ti/drivers/Board", {}, false);
var DriverLib = scripting.addModule("/ti/devices/DriverLib", {}, false);
// Name
I2C1.i2c.$name = "MyI2C1";
// Assign pin
I2C1.i2c.sdaPin.$assign = "boosterpack.10"; // P02
// Assign pin
I2C1.i2c.sclPin.$assign = "boosterpack.9"; // P01
// Name - The C/C++ identifier used in applications as the index parameter passed to UART runtime APIs
UART1.$name = "CONFIG_UART_0";
// Use Hardware - Select the hardware to use, or 'None' to use available header pins
UART1.$hardware = system.deviceData.board.components.XDS110UART;
// Name
UART1.uart.$name = "MyUART1";
// Name - The C/C++ identifier used in applications as the index parameter passed to Timer runtime APIs
Timer1.$name = "CONFIG_TIMER_0";
// Timer Type
Timer1.timerType = "32 Bits";
// Name
Timer1.timer.$name = "MyTimer1";
// Name - The C/C++ identifier used in applications as the index parameter passed to Timer runtime APIs
Timer2.$name = "CONFIG_TIMER_1";
// Timer Type
Timer2.timerType = "32 Bits";
// Name
Timer2.timer.$name = "MyTimer1";
// Name - The C/C++ identifier used in applications as the index parameter passed to GPIO runtime APIs
GPIO1.$name = "CONFIG_GPIO_0";
// Use Hardware - Select the hardware to use, or 'None' to use available header pins
GPIO1.$hardware = system.deviceData.board.components.SW2;
// Name - The C/C++ identifier used in applications as the index parameter passed to GPIO runtime APIs
GPIO2.$name = "CONFIG_GPIO_1";
// Use Hardware - Select the hardware to use, or 'None' to use available header pins
GPIO2.$hardware = system.deviceData.board.components.SW3;
// Suggest solution
I2C1.i2c.$suggestSolution = "I2C0";
// Suggest solution
UART1.uart.$suggestSolution = "UART0";
// Suggest solution
UART1.uart.txPin.$suggestSolution = "55";
// Suggest solution
UART1.uart.rxPin.$suggestSolution = "57";
// Suggest solution
Timer1.timer.$suggestSolution = "Timer1";
// Suggest solution
Timer2.timer.$suggestSolution = "Timer0";
// Suggest solution
GPIO1.gpioPin.$suggestSolution = "4";
// Suggest solution
GPIO2.gpioPin.$suggestSolution = "15";
